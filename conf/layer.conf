## conf/layer.conf
```bitbake
BBPATH .= ":${LAYERDIR}"

BBFILES += "${LAYERDIR}/recipes-*/*/*.bb \
            ${LAYERDIR}/recipes-*/*/*.bbappend \
            ${LAYERDIR}/recipes-*/*.bb \
            ${LAYERDIR}/recipes-*/*.bbappend"

BBFILE_COLLECTIONS += "cm4custom"
BBFILE_PATTERN_cm4custom = "^${LAYERDIR}/"
BBFILE_PRIORITY_cm4custom = "8"

LAYERSERIES_COMPAT_cm4custom = "kirkstone"
```

## conf/machine/cm4-industrial.conf
```bitbake
require conf/machine/raspberrypi4-64.conf

MACHINEOVERRIDES =. "cm4-industrial:"

ENABLE_UART = "1"
RPI_USE_U_BOOT = "1"
DISABLE_RPI_BOOT_LOGO = "1"
IMAGE_FSTYPES += "wic.bz2"
hostname_pn-base-files = "cm4-edge"
DEFAULTTUNE ?= "cortexa72-crypto"

CM4_ENABLE_CAN_SPI = "1"
CM4_ENABLE_RS485 = "1"
```

## meta-dl-device/conf/layer.conf
```bitbake
# meta-dl-device/conf/layer.conf

BBPATH .= ":${LAYERDIR}"

BBFILES += " \
    ${LAYERDIR}/recipes-*/*/*.bb \
    ${LAYERDIR}/recipes-*/*/*.bbappend \
"

BBFILE_COLLECTIONS += "dldevice"
BBFILE_PATTERN_dldevice = "^${LAYERDIR}/"
BBFILE_PRIORITY_dldevice = "7"

# Adjust to your Yocto series
LAYERSERIES_COMPAT_dldevice = "scarthgap"
```
